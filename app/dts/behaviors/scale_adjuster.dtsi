/*
 * Custom behavior for dynamic scale adjustment
 */

/ {
    behaviors {
        scale_adjuster: scale_adjuster {
            compatible = "zmk,beh-scale-adjuster";
            label = "SCALE_ADJUSTER";
            #binding-cells = <2>; /* Two cells: row, column */
            /* The properties below are placeholders. Adjust them according to your needs */
            temp_multiplier = <23>; /* Temporary scale multiplier */
            temp_divisor = <8>; /* Temporary scale divisor */
        };
    };
};