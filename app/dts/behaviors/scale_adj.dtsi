/*
 * Custom behavior for dynamic scale adjustment
 */

/ {
    behaviors {
        scale_adj: scale_adj {
            compatible = "zmk,beh-scale-adjuster";
            #binding-cells = <0>;
            /* The properties below are placeholders. Adjust them according to your needs */
            temp_multiplier = <23>; /* Temporary scale multiplier */
            temp_divisor = <8>; /* Temporary scale divisor */
        };
    };
};