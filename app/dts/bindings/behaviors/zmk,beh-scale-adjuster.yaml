## app/dts/bindings/behaviors/zmk,beh-scale-adjuster.yaml
```yaml
description: Custom behavior for dynamic scale adjustment

compatible: "zmk,behavior-scale-adjuster"

include: zero_param.yaml

properties:
  temp_multiplier:
    type: int
    required: false
    description: Temporary scale multiplier

  temp_divisor:
    type: int
    required: false
    description: Temporary scale divisor
```

## app/src/studio/Kconfig
```kconfig
menuconfig ZMK_STUDIO
    bool "Studio Support"
    select NANOPB
    select ZMK_BEHAVIOR_METADATA
    help
      Add firmware support for realtime keymap updates (ZMK Studio

if ZMK_STUDIO

config ZMK_STUDIO_MAX_MSG_SIZE
    int "Max RPC message size"
    default 64

menu "Interfaces"

config ZMK_STUDIO_INTERFACE_UART
    bool "Serial"
    select SERIAL
    select NET_BUF
    default y if ZMK_USB

config ZMK_STUDIO_INTERFACE_BLE
    bool "BLE (GATT)"
    select NET_BUF
    depends on ZMK_BLE
    default y

endmenu

endif
```
